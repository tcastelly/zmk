## app/boards/arm/angry_miao_hatsu/Kconfig.board
```kconfig
# nRF52840 DK NRF52840 board configuration

# Copyright (c) 2016 Nordic Semiconductor ASA
# SPDX-License-Identifier: Apache-2.0

config BOARD_ANGRY_MIAO_HATSU_RIGHT
	bool "Angry Miao Hatsu Right"
	depends on SOC_NRF52840_QIAA

config BOARD_ANGRY_MIAO_HATSU_LEFT
	bool "Angry Miao Hatsu Left"
	depends on SOC_NRF52840_QIAA
```

## app/boards/arm/angry_miao_hatsu/Kconfig.defconfig
```kconfig
if BOARD_ANGRY_MIAO_HATSU_LEFT

config ZMK_KEYBOARD_NAME
    default "Angry Miao Hatsu"

config ZMK_SPLIT_ROLE_CENTRAL
    default y

endif # BOARD_ANGRY_MIAO_HATSU_RIGHT

if BOARD_ANGRY_MIAO_HATSU_LEFT || BOARD_ANGRY_MIAO_HATSU_RIGHT

config BOARD
	default "angry_miao_hatsu"

config BT_CTLR
	default BT

config BT
    default y

config ZMK_BLE
    default y

config ZMK_SPLIT
    default y

config USB_NRFX
    default y

config ZMK_USB
    default y

endif # BOARD_ANGRY_MIAO_HATSU_LEFT || BOARD_ANGRY_MIAO_HATSU_RIGHT
```

## app/boards/arm/angry_miao_hatsu/angry_miao_hatsu_right_defconfig
```kconfig
# SPDX-License-Identifier: Apache-2.0

CONFIG_SOC_SERIES_NRF52X=y
CONFIG_SOC_NRF52840_QIAA=y
CONFIG_BOARD_ANGRY_MIAO_HATSU_RIGHT=y

CONFIG_ZMK_KEYBOARD_NAME="Hatsu Right"

# Enable MPU
CONFIG_ARM_MPU=y

# Enable hardware stack protection
CONFIG_HW_STACK_PROTECTION=y

# Enable RTT
CONFIG_USE_SEGGER_RTT=y

# enable GPIO
CONFIG_GPIO=y

# enable uart driver
CONFIG_SERIAL=y

# enable console
CONFIG_CONSOLE=y
CONFIG_UART_CONSOLE=y

# additional board options
CONFIG_GPIO_AS_PINRESET=n
CONFIG_NFCT_PINS_AS_GPIOS=y

CONFIG_PINCTRL=y

CONFIG_ZMK_BLE=y

# Enable 32kHz crystal
CONFIG_CLOCK_CONTROL_NRF_K32SRC_XTAL=y
CONFIG_CLOCK_CONTROL_NRF_K32SRC_30PPM=y

CONFIG_SPI=y
CONFIG_ZMK_BACKLIGHT=y
CONFIG_ZMK_BACKLIGHT_MAP=y

CONFIG_I2C=y
CONFIG_ZMK_BATTERY=y
CONFIG_ZMK_BATTERY_INDICATOR=y
CONFIG_ZMK_BATTERY_INDICATOR_BAR=y
CONFIG_ZMK_BATTERY_INDICATOR_COLOR=0x0000FF
CONFIG_ZMK_BATTERY_INDICATOR_DEFAULT_COLOR=0xC70039

CONFIG_USE_DT_CODE_PARTITION=y
CONFIG_BUILD_OUTPUT_UF2=y
CONFIG_MPU_ALLOW_FLASH_WRITE=y
CONFIG_NVS=y
CONFIG_SETTINGS=y
CONFIG_SETTINGS_NVS=y
CONFIG_FLASH=y
CONFIG_FLASH_PAGE_LAYOUT=y
CONFIG_FLASH_MAP=y
CONFIG_BT_SMP=y

CONFIG_BT_CTLR_TX_PWR_PLUS_8=y

CONFIG_ZMK_BOOT_MAGIC_KEY=y
CONFIG_BT_GAP_AUTO_UPDATE_CONN_PARAMS=y
```

## app/dts/bindings/behaviors/zmk,behavior-battery-indicator.yaml
```yaml
# Copyright (c) 2023 The ZMK Contributors
# SPDX-License-Identifier: MIT

description: Battery Indicator Behavior

compatible: "zmk,behavior-battery-indicator"

include: one_param.yaml
```

## app/dts/bindings/zmk,backlight-map.yaml
```yaml
description: |
  Allows defining a keymap composed of multiple layers

compatible: "zmk,backlight-map"

properties:
  led-channels:
    type: phandle-array
    required: true
  colors:
    type: uint8-array 
    required: false 
```

## app/module/drivers/sensor/cw2015/Kconfig
```kconfig
# Copyright (c) 2022 The ZMK Contributors
# SPDX-License-Identifier: MIT

DT_COMPAT_CELLWISE_CW2015 := cellwise,cw2015

menuconfig CW2015
    bool "CW2015 I2C-based Fuel Gauge"
    default $(dt_compat_enabled,$(DT_COMPAT_CELLWISE_CW2015))
    depends on I2C
    select ZMK_BATTERY
    help
      Enable driver for CW2015 I2C-based Fuel Gauge. Supports measuring
      battery voltage and state-of-charge.

if CW2015

config SENSOR_CW2015_INIT_PRIORITY
    int "Init priority"
    default 75
    help
      Device driver initialization priority.

endif #CW2015
```

## app/module/dts/bindings/sensor/cellwise,cw2015.yml
```yaml
#
# Copyright (c) 2022 The ZMK Contributors
#
# SPDX-License-Identifier: MIT
#

description: >
  CW2015 Fuel Gauge

compatible: "cellwise,cw2015"

include: [i2c-device.yaml]
```

## app/west.yml
```yaml
manifest:
  remotes:
    - name: zephyrproject-rtos
      url-base: https://github.com/zephyrproject-rtos
    - name: zmkfirmware
      url-base: https://github.com/zmkfirmware
    - name: hlord2000
      url-base: https://github.com/hlord2000
  projects:
    - name: zephyr
      remote: hlord2000 
      revision: v3.2.0+zmk-fixes
      clone-depth: 1
      import:
        name-blocklist:
          - ci-tools
          - hal_altera
          - hal_cypress
          - hal_infineon
          - hal_microchip
          - hal_nxp
          - hal_openisa
          - hal_silabs
          - hal_xtensa
          - hal_st
          - hal_ti
          - loramac-node
          - mcuboot
          - mcumgr
          - net-tools
          - openthread
          - edtt
          - trusted-firmware-m
    - name: nanopb
      revision: 65cbefb4695bc7af1cb733ced99618afb3586b20
      path: modules/lib/nanopb
      remote: zephyrproject-rtos
    - name: zmk-studio-messages
      revision: 42446798e357e8021c5202a01ea250a34a776e85
      path: modules/msgs/zmk-studio-messages
      remote: zmkfirmware
  self:
    west-commands: scripts/west-commands.yml
```
