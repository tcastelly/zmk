/*
 * Copyright (c) 2023 The ZMK Contributors
 *
 * SPDX-License-Identifier: MIT
 */

/ {
    behaviors {
        /omit-if-no-ref/ bat: behavior_battery_indicator {
            compatible = "zmk,behavior-battery-indicator";
            label = "BAT_IND";
            #binding-cells = <1>;
        };
    };
};
